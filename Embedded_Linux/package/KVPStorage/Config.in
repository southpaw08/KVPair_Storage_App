## Embedded_Linux/package/KVPStorage/Config.in
```kconfig
config BR2_PACKAGE_KVPSTORAGE
	bool "KVPSTORAGE"
	help
	  Clay's Key Value pair storage application

comment "Needs C++ support to be activated in toolchain"
```
